## arch/arm/configs/cyanogen_lt02lte_spr_defconfig
```kconfig
CONFIG_MACH_LT02=y
CONFIG_MACH_LT02_SPR=y
# CONFIG_MACH_SERRANO is not set
CONFIG_MSM_DCVS=y
CONFIG_MSM_HSIC_SYSMON=y
# CONFIG_EXT_MAINMIC_BIAS is not set
CONFIG_EXT_SPK_AMP=y
# CONFIG_EXT_EARMIC_BIAS is not set
# CONFIG_SEC_THERMISTOR is not set
# CONFIG_2MIC_QUP_I2C is not set
CONFIG_MARIMBA_CORE=y
CONFIG_BT_RFCOMM=y
CONFIG_BT_RFCOMM_TTY=y
CONFIG_BT_BNEP=y
CONFIG_BT_BNEP_MC_FILTER=y
CONFIG_BT_BNEP_PROTO_FILTER=y
CONFIG_HID_SUPPORT=y
CONFIG_UHID=y
CONFIG_HIDRAW=y
CONFIG_BT_HCISMD=y
CONFIG_BT_HCIUART=y
CONFIG_BT_HCIUART_ATH3K=y
CONFIG_BT_HCIUART_H4=y
CONFIG_BT_HCIUART_IBS=y
CONFIG_MSM_BT_POWER=y
# CONFIG_CFG80211_INTERNAL_REGDB is not set
CONFIG_GENLOCK=y
CONFIG_GENLOCK_MISCDEVICE=y
# CONFIG_USB_SWITCH_TSU6721 is not set
# CONFIG_SAMSUNG_JACK_GNDLDET is not set
CONFIG_USB_SWITCH_FSA9485=y
CONFIG_TSU6721_CDP_FIX=y
# CONFIG_NFC_PN547 is not set
CONFIG_NFC_PMIC_CLK=y
# CONFIG_USB_HSIC_SMSC_HUB=y
CONFIG_MSM_RMNET_SMUX=y
CONFIG_USB_USBNET=y
CONFIG_MSM_RMNET_USB=y
# CONFIG_KEYBOARD_GPIO_EXTENDED_RESUME_EVENT is not set
# CONFIG_KEYBOARD_TC360_TOUCHKEY is not set
# CONFIG_SENSORS_HALL is not set
CONFIG_TOUCHSCREEN_ZINITIX_BT532=y
# CONFIG_TOUCHSCREEN_MXTS is not set
# CONFIG_TOUCHSCREEN_MXT336S is not set
# CONFIG_INPUT_MPU6050 is not set
# CONFIG_INPUT_MPU6050_SELFTEST is not set
# CONFIG_INPUT_MPU6050_POLLING is not set
# CONFIG_INPUT_MPU6500 is not set
# CONFIG_INPUT_MPU6500_SELFTEST is not set
# CONFIG_INPUT_MPU6500_POLLING is not set
CONFIG_N_SMUX=y
CONFIG_N_SMUX_LOOPBACK=y
CONFIG_SMUX_CTL=y
#CONFIG_SERIAL_MSM_HS=y
CONFIG_POWER_SUPPLY=y
# CONFIG_PM8921_BMS is not set
# CONFIG_PM8921_SEC_CHARGER is not set
# CONFIG_WIRELESS_CHARGER=y is not set
CONFIG_BATTERY_SAMSUNG=y
CONFIG_CHARGER_SMB358=y
CONFIG_FUELGAUGE_MAX17050=y
CONFIG_FUELGAUGE_MAX17050_COULOMB_COUNTING=y
CONFIG_ADC_STMPE811=y
CONFIG_USB_VIDEO_CLASS=y
# CONFIG_S5K3H5XA is not set
# CONFIG_IMX175 is not set
# CONFIG_S5K6A3YX is not set
# CONFIG_IMX175 is not set
CONFIG_ISX012=n
CONFIG_SR030PC50=n
CONFIG_S5K5CCGX=y
CONFIG_SR130PC20=y
# CONFIG_S5K6A3YX is not set
# CONFIG_MSM_ACTUATOR is not set
# CONFIG_MSM_EEPROM is not set
# CONFIG_IMX175_EEPROM is not set
# CONFIG_FEATURE_FLIPLR is not set
CONFIG_FB_MDP4_ENHANCE=y
# CONFIG_FB_MSM_MIPI_SAMSUNG_OLED_VIDEO_QHD_PT_PANEL is not set
# CONFIG_FB_MSM_HDMI_MSM_PANEL is not set
# CONFIG_MDNIE_LITE_TUNING is not set
CONFIG_FB_MSM_MIPI_SAMSUNG_TFT_VIDEO_WSVGA_PT_PANEL=y
# CONFIG_MDP_SHUTDOWN is not set
# CONFIG_MIPI_SAMSUNG_OLED_VIDEO_QHD_MIPICLK_461 is not set
# CONFIG_RUNTIME_MIPI_CLK_CHANGE is not set
CONFIG_MIPI_DSI_LP_CMD_SEND=y
# CONFIG_MIPI_DSI_LP_RX is not set
CONFIG_FB_MSM_HDMI_MSM_PANEL=y
CONFIG_SND_USB_AUDIO=y
# CONFIG_HIDRAW is not set
# CONFIG_UHID is not set
CONFIG_DOCK_EN=y
# CONFIG_HID_PID is not set
# CONFIG_USB_HIDDEV is not set
CONFIG_HID_A4TECH=y
CONFIG_HID_ACRUX=y
# CONFIG_HID_ACRUX_FF is not set
CONFIG_USB_ANDROID_SAMSUNG_MTP=y
# CONFIG_MSM_VIBRATOR is not set
CONFIG_SENSORS_K3DH=y
CONFIG_SENSOR_K3DH_INPUTDEV=y
CONFIG_INPUT_YAS_MAGNETOMETER_POSITION=7
CONFIG_INPUT_YAS_ORIENTATION=y
CONFIG_GRIP_SENSOR=y
CONFIG_SENSORS_AD7146=y
#CONFIG_PROXIMITY_SENSOR is not set
```
